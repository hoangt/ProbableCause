
#include "io430.h"
#include "stdint.h"
//const char image[30800] = {15,15,15,15,15,15,15,15,15,15,15,15,15,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15,15};


// Define the flash memory range
// Where we write results
#define SEGMENT_DATA_START     0x09000
#define SEGMENT_DATA_END       0x10000

// Signal port masks
#define RELAY_MASK   0x1
#define W_MASK       0x2
#define OE_MASK      0x4
#define RAS_MASK     0x8
#define CAS_MASK     0x10
#define DATA_MASK    0xF
#define FLAG1_MASK   0x20
#define FLAG2_MASK   0x40
#define ADDRESS_MASK 0xFF

// Flags to aid processing of DAq output
#define set_flag1_high()        P1OUT |= FLAG1_MASK
#define set_flag1_low()         P1OUT &= ~FLAG1_MASK
#define set_flag2_high()        P1OUT |= FLAG2_MASK
#define set_flag2_low()         P1OUT &= ~FLAG2_MASK

// Power gating relay
#define power_on()              P1OUT |= RELAY_MASK
#define power_off()             P1OUT &= ~RELAY_MASK

// DRAM interface signals
#define set_w_high()            P1OUT |= W_MASK
#define set_w_low()             P1OUT &= ~W_MASK
#define set_oe_high()           P1OUT |= OE_MASK
#define set_oe_low()            P1OUT &= ~OE_MASK
#define set_ras_high()          P1OUT |= RAS_MASK
#define set_ras_low()           P1OUT &= ~RAS_MASK
#define set_cas_high()          P1OUT |= CAS_MASK
#define set_cas_low()           P1OUT &= ~CAS_MASK
#define set_address(pos)        P4OUT = (pos) // P4 is 8 bits
#define read_data()             (P3IN & DATA_MASK) // Data is 4 bits
#define write_data(v)           P3OUT = (P3OUT & ~DATA_MASK) | ((v) & DATA_MASK) // P3 is 8 bits and data is 4



#define TESTTIME 0 
#define DELAY 1000000
#define COL 0x100
#define ROW 0x80
#define LENGTH 256


void flash_wb(char *Flash_ptr , int value){
  __disable_interrupt();
  FCTL3 = FWKEY;                            // Clear Lock bit
  //FCTL1 = FWKEY + ERASE;                    // Set Erase bit
 // *Flash_ptr = 0;                           // Dummy write to erase Flash seg
  FCTL1 = FWKEY + WRT;                      // Set WRT bit for write operation
  *Flash_ptr++ = value;                     // Write value to flash
  while((FCTL3 & BUSY));
  FCTL1 = FWKEY;                            // Clear WRT bit
  FCTL3 = FWKEY + LOCK;                     // Set LOCK bit
  __enable_interrupt();
}

void write_Seg( char *Flash_ptr,char value)
{
  unsigned int i;
  FCTL3 = FWKEY;                            // Clear Lock bit
  FCTL1 = FWKEY + ERASE;                    // Set Erase bit
  *Flash_ptr = 0;                           // Dummy write to erase Flash seg

  FCTL1 = FWKEY + WRT;                      // Set WRT bit for write operation

  for (i = 0; i < 64; i++)
  {
    *Flash_ptr++ = value;                   // Write value to flash
  }

  FCTL1 = FWKEY;                            // Clear WRT bit
  FCTL3 = FWKEY + LOCK;                     // Set LOCK bit
}

inline void dram_ref(char row){
  set_ras_high();
  set_address(row);
  set_ras_low();
  set_ras_high();
  set_address(0x0);
}

inline void dram_wb(char row, char column, char value){
  P3DIR |= DATA_MASK; // Lower 4 bits out to DRAM data
  set_ras_high();
  set_cas_high();
  set_address(row);
  set_ras_low();
  set_w_low();
  set_address(column);
  write_data(value); 
  set_cas_low();
  set_cas_high();
  set_ras_high();
  set_ras_low();
  set_ras_high();
  //set_address(0x0);
  //write_data(0x0);
}

inline char dram_rb(char row, char column){
  P3DIR &= ~DATA_MASK; // Lower 4 bits in from DRAM data
  set_ras_high();
  set_w_high();
  set_oe_low();
  set_cas_high();
  set_address(row);
  set_ras_low();
  set_address(column);
  set_cas_low();
  char value = read_data();
  set_cas_high();
  set_ras_high();
  set_ras_low();
  set_ras_high();
  //set_address(0x0);
 // __delay_cycles(2);
  return value;
}



int main( void )
{
  // Stop watchdog timer to prevent time out reset
  WDTCTL = WDTPW + WDTHOLD;


  // Set ports direction
  P1SEL = 0x00;
  P2SEL = 0x00;
  P3SEL = 0x00;
  P1DIR = 0xFF; //Control bits
  P4DIR = 0xFF; //Address bits
  P1OUT = 0x00;
  P2OUT = 0x00;
  power_on();
  

  char* address = (char*)SEGMENT_DATA_START; //memory location for data storage

//  while(address< (char*) SEGMENT_DATA_END +0x100){
  
 // for(unsigned long cc=TESTSTART;cc<TESTEND+1;cc+=TESTSTEP)
 // {
    int cc=TESTTIME;
    int * img_ptr = (int *)0x5000;

    //write cycle
    //int i=ROW;
    for(int i=0;i<ROW;++i)
      {
        for(int j=0;j<COL;++j)
        {
          int c = *img_ptr;
          char temp=c&0xF;
          dram_wb(i,j,temp);
          j++;
          temp=(c&0xF0)>>4;
          dram_wb(i,j,temp);
          j++;
          temp=(c&0xF00)>>8;
          dram_wb(i,j,temp);
          j++;
          temp=(c&0xF000)>>12;
          dram_wb(i,j,temp);
          img_ptr++;
        }
    }
    //power_off();
    for(int k=0;k<=cc;++k)
      __delay_cycles(DELAY);
    //power_on();
    for(int i = 0; i < ROW; ++i){
        for(int j = 0; j < COL; ++j){
          uint32_t flashdata=0;
          char dataFromDRAM = dram_rb(i, j);
          flashdata=flashdata|(dataFromDRAM&0xF);
          j++;
          dataFromDRAM = dram_rb(i, j);
          flashdata=(flashdata<<4)|(dataFromDRAM&0xF);
          j++;
          dataFromDRAM = dram_rb(i, j);
          flashdata=(flashdata<<4)|(dataFromDRAM&0xF);
          j++;
          dataFromDRAM = dram_rb(i, j);
          flashdata=(flashdata<<4)|(dataFromDRAM&0xF);
 
          flash_wb(address,flashdata);
          address++;
        }
      }
    

    address++;


 // }

    return 0;
}
